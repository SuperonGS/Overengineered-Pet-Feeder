#include <Wire.h>
#include <Adafruit_GFX.h>
#include <Adafruit_SSD1306.h>
#include "HX711.h"

// OLED
#define SCREEN_WIDTH 128
#define SCREEN_HEIGHT 64
Adafruit_SSD1306 display(SCREEN_WIDTH, SCREEN_HEIGHT, &Wire, -1);

// HX711
#define DT_PIN 2
#define SCK_PIN 3
HX711 scale;

// DRV8825
#define STEP_PIN 6
#define DIR_PIN 5
#define ENABLE_PIN 4

// Switch and buzzer
#define SWITCH_PIN 8
#define BUZZER_PIN 7

const unsigned char _pawsonair [] PROGMEM = {
	0x00, 0x00, 0x00, 0x00, 0x00, 0x00, 0x00, 0x00, 0x00, 0x00, 0x00, 0x00, 0x00, 0x00, 0x00, 0x00, 
	0x00, 0x00, 0x00, 0x00, 0x00, 0x00, 0x00, 0x00, 0x00, 0x00, 0x00, 0x00, 0x00, 0x00, 0x00, 0x00, 
	0x00, 0x00, 0x00, 0x00, 0x00, 0x00, 0x00, 0x00, 0x00, 0x00, 0x00, 0x00, 0x00, 0x00, 0x00, 0x00, 
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	0x00, 0x00, 0x00, 0x00, 0x00, 0x00, 0x00, 0x00, 0x00, 0x00, 0x00, 0x00, 0x00, 0x1f, 0x80, 0x00
};
const unsigned char _rightpawontable [] PROGMEM = {
	0x00, 0x00, 0x00, 0x00, 0x00, 0x00, 0x00, 0x00, 0x00, 0x00, 0x00, 0x00, 0x00, 0x00, 0x00, 0x00, 
	0x00, 0x00, 0x00, 0x00, 0x00, 0x00, 0x00, 0x00, 0x00, 0x00, 0x00, 0x00, 0x00, 0x00, 0x00, 0x00, 
	0x00, 0x00, 0x00, 0x00, 0x00, 0x00, 0x00, 0x00, 0x00, 0x00, 0x00, 0x00, 0x00, 0x00, 0x00, 0x00, 
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	0x00, 0x00, 0x00, 0x00, 0x00, 0x00, 0x00, 0x00, 0x00, 0x00, 0x00, 0x00, 0x00, 0x1f, 0x80, 0x00
};
const unsigned char _leftpawontable [] PROGMEM = {
	0x00, 0x00, 0x00, 0x00, 0x00, 0x00, 0x00, 0x00, 0x00, 0x00, 0x00, 0x00, 0x00, 0x00, 0x00, 0x00, 
	0x00, 0x00, 0x00, 0x00, 0x00, 0x00, 0x00, 0x00, 0x00, 0x00, 0x00, 0x00, 0x00, 0x00, 0x00, 0x00, 
	0x00, 0x00, 0x00, 0x00, 0x00, 0x00, 0x00, 0x00, 0x00, 0x00, 0x00, 0x00, 0x00, 0x00, 0x00, 0x00, 
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	0x00, 0x00, 0x00, 0x00, 0x00, 0x00, 0x00, 0x00, 0x00, 0x00, 0x00, 0x00, 0x00, 0x1f, 0x80, 0x00
};
const unsigned char _pawsontable [] PROGMEM = {
	0x00, 0x00, 0x00, 0x00, 0x00, 0x00, 0x00, 0x00, 0x00, 0x00, 0x00, 0x00, 0x00, 0x00, 0x00, 0x00, 
	0x00, 0x00, 0x00, 0x00, 0x00, 0x00, 0x00, 0x00, 0x00, 0x00, 0x00, 0x00, 0x00, 0x00, 0x00, 0x00, 
	0x00, 0x00, 0x00, 0x00, 0x00, 0x00, 0x00, 0x00, 0x00, 0x00, 0x00, 0x00, 0x00, 0x00, 0x00, 0x00, 
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	0x00, 0x00, 0x00, 0x00, 0x00, 0x00, 0x00, 0x00, 0x00, 0x00, 0x00, 0x00, 0x00, 0x1f, 0x80, 0x00
};

const unsigned char* frames[] = {
  _pawsonair,
  _leftpawontable,
  _pawsonair,
  _rightpawontable,
  _pawsonair,
  _pawsontable
};
const int frameCount = sizeof(frames) / sizeof(frames[0]);
int currentFrame = 0;
unsigned long lastUpdate = 0;
const unsigned long frameDelay = 200;

enum OledMode {
  BONGO_CAT,
  WEIGHT,
  MEASURING,
  REFILL
};

OledMode oled_mode = BONGO_CAT;
OledMode previous_mode = BONGO_CAT;

float foodAmount = 0;
bool refilling = false;
bool lastFoodLow = false;
float portionGrams = 5.0;
int portionSteps = 200;

// TCP-like UART communication buffer and state
String incomingMessage = "";
bool awaitingAck = false;
unsigned long lastSendTime = 0;
const unsigned long ackTimeout = 1000;
String lastSentMessage = "";

void setup() {
  Serial.begin(9600);

  if (!display.begin(SSD1306_SWITCHCAPVCC, 0x3C)) {
    while (true);
  }
  display.clearDisplay();
  display.display();

  scale.begin(DT_PIN, SCK_PIN);
  scale.set_offset(212959);
  scale.set_scale(-23.544778);

  pinMode(STEP_PIN, OUTPUT);
  pinMode(DIR_PIN, OUTPUT);
  pinMode(ENABLE_PIN, OUTPUT);
  pinMode(SWITCH_PIN, INPUT_PULLUP);
  pinMode(BUZZER_PIN, OUTPUT);

  digitalWrite(ENABLE_PIN, HIGH);
}

void loop() {
  handleSerialTCP();
  handleOledDisplay();
  handleRefilling();
  handleCatDetection();
}

void sendMessageWithAck(const String& msg) {
  if (!awaitingAck) {
    Serial.println(msg);
    lastSentMessage = msg;
    lastSendTime = millis();
    awaitingAck = true;
  } else if (millis() - lastSendTime > ackTimeout) {
    Serial.println(lastSentMessage);
    lastSendTime = millis();
  }
}

void handleSerialTCP() {
  while (Serial.available()) {
    char ch = Serial.read();
    if (ch == '\n') {
      incomingMessage.trim();
      if (incomingMessage == "ACK") {
        awaitingAck = false;
      } else {
        processCommand(incomingMessage);
        Serial.println("ACK");
      }
      incomingMessage = "";
    } else {
      incomingMessage += ch;
    }
  }
}

void processCommand(const String& cmd) {
  if (cmd.startsWith("MODE:")) {
    String mode = cmd.substring(5);
    if (mode == "bongo") oled_mode = BONGO_CAT;
    else if (mode == "weight") oled_mode = WEIGHT;
  } else if (cmd.startsWith("FEED:")) {
    int portions = cmd.substring(5).toInt();
    feed(portions);
  } else if (cmd == "BUZZ") {
    tone(BUZZER_PIN, 2000);
    delay(150);
    noTone(BUZZER_PIN);
  }
}

void feed(int portions) {
  int totalSteps = portions * portionSteps;
  digitalWrite(ENABLE_PIN, LOW);
  digitalWrite(DIR_PIN, HIGH);
  for (int i = 0; i < totalSteps; i++) {
    digitalWrite(STEP_PIN, HIGH);
    delayMicroseconds(800);
    digitalWrite(STEP_PIN, LOW);
    delayMicroseconds(800);
  }
  digitalWrite(ENABLE_PIN, HIGH);
}

void showMessage(const char* message) {
  display.clearDisplay();
  display.setTextSize(2);
  display.setCursor(0, 10);
  display.setTextColor(SSD1306_WHITE);
  display.println(message);
  display.display();
}

void handleOledDisplay() {
  if (oled_mode == WEIGHT) {
    float weight = scale.get_units(5);
    if (abs(weight) < 1.0 || weight < 0) weight = 0.0;
    display.clearDisplay();
    display.setTextSize(1);
    display.setCursor(0, 0);
    display.setTextColor(SSD1306_WHITE);
    display.print("Scale Reading:");
    display.setTextSize(2);
    display.setCursor(0, 20);
    display.print(weight, 1);
    display.print(" g");
    display.display();
  } else if (oled_mode == BONGO_CAT) {
    unsigned long now = millis();
    if (now - lastUpdate > frameDelay) {
      lastUpdate = now;
      display.clearDisplay();
      display.drawBitmap(0, 12, frames[currentFrame], 128, 40, SSD1306_WHITE);
      display.display();
      currentFrame = (currentFrame + 1) % frameCount;
    }
  } else if (oled_mode == REFILL) {
    showMessage("Refilling food...");
  } else if (oled_mode == MEASURING) {
    showMessage("Measuring cat...");
  }
}

void handleRefilling() {
  static bool switchLastState = HIGH;
  static float refillStartWeight = 0;
  bool switchState = digitalRead(SWITCH_PIN);

  if (switchLastState == HIGH && switchState == LOW) {
    refilling = true;
    refillStartWeight = scale.get_units(5);
    if (abs(refillStartWeight) < 1.0) refillStartWeight = 0.0;
    previous_mode = oled_mode;
    oled_mode = REFILL;
  } else if (switchLastState == LOW && switchState == HIGH) {
    float afterRefillWeight = scale.get_units(5);
    if (abs(afterRefillWeight) < 1.0) afterRefillWeight = 0.0;
    float added = afterRefillWeight - refillStartWeight;
    if (added > 50.0) {
      foodAmount += added;
      sendMessageWithAck("FOOD:OK");
    }
    refilling = false;
    oled_mode = previous_mode;
  }
  switchLastState = switchState;
}

void handleCatDetection() {
  static bool catDetected = false;
  static float beforeCatWeight = 0;
  float currentWeight = scale.get_units(5);
  if (abs(currentWeight) < 1.0) currentWeight = 0.0;

  if (!refilling && !catDetected && currentWeight > foodAmount + 500) {
    catDetected = true;
    previous_mode = oled_mode;
    oled_mode = MEASURING;
    beforeCatWeight = currentWeight;
    delay(5000);
  }

  if (catDetected) {
    if (currentWeight <= beforeCatWeight - 300) {
      float afterCatWeight = scale.get_units(5);
      if (abs(afterCatWeight) < 1.0) afterCatWeight = 0.0;
      float catWeight = beforeCatWeight - afterCatWeight;
      if (catWeight < 0) catWeight = 0;

      sendMessageWithAck("WEIGHT:" + String(catWeight, 1));

      foodAmount = afterCatWeight;
      if (!refilling) {
        bool isLow = (foodAmount < 100);
        if (isLow != lastFoodLow) {
          sendMessageWithAck(isLow ? "FOOD:LOW" : "FOOD:OK");
          lastFoodLow = isLow;
        }
      }

      oled_mode = previous_mode;
      catDetected = false;
    }
  }
}

